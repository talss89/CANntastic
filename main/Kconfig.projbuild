## main/Kconfig.projbuild
```kconfig
menu "Cantastic Configuration"

    orsource "$IDF_PATH/examples/common_components/env_caps/$IDF_TARGET/Kconfig.env_caps"

    choice CT_VEHICLE_MODEL
        prompt "Vehicle Model"
        default CT_VEHICLE_TIGER1200_GEN3
        help
            Select a vehicle model.
        config CT_VEHICLE_TIGER1200_GEN3
            bool  "Triumph Tiger 1200 Gen3 (Chassis ECM)"
        config CT_VEHICLE_GENERIC
            bool  "Generic - Non CAN"
    endchoice

    choice CT_CONTROL_SCHEME
        prompt "Control Scheme"
        default CT_SCHEME_BASIC
        help
            Select a control scheme.
        config CT_SCHEME_BASIC
            bool  "Basic"
        config CT_SCHEME_WEBCONFIG
            bool  "Web Config"
    endchoice

    config CT_WEB_CONFIG_MAX_RULES
        int "Web config - max rules"
        range 1 32
        default 16
        help
            Max number of web confir scheme rules per page


    config CT_CUSTOM_GPIO
        bool
        default n
        prompt "Enable the custom/gpio.h configuration?"
        help
            Gives the ability to map custom GPIO to button events.

    config CT_DMD2_EVAL
        bool
        default n
        prompt "Change device name to DMD2 controller compatible"
        help
            Enable this to allow DMD2 to pick up the uncertified device.

    config CT_CANBUS_TX_PIN
        int "CAN Transciever TX Pin"
        range ENV_GPIO_RANGE_MIN ENV_GPIO_IN_RANGE_MAX
        default 5
        help
            GPIO number for CAN transciever TX pin.

    config CT_CANBUS_RX_PIN
        int "CAN Transciever RX Pin"
        range ENV_GPIO_RANGE_MIN ENV_GPIO_IN_RANGE_MAX
        default 4
        help 
            GPIO number for CAN transciever RX pin.

    choice EXAMPLE_USE_IO_TYPE
        prompt "I/O Capability"
        default BLE_SM_IO_CAP_NO_IO
        help
            I/O capability of device.

        config BLE_SM_IO_CAP_DISP_ONLY
            bool "DISPLAY ONLY"
        config BLE_SM_IO_CAP_DISP_YES_NO
            bool "DISPLAY YESNO"
        config BLE_SM_IO_CAP_KEYBOARD_ONLY
            bool "KEYBOARD ONLY"
        config BLE_SM_IO_CAP_NO_IO
            bool "Just works"
        config BLE_SM_IO_CAP_KEYBOARD_DISP
            bool "Both KEYBOARD & DISPLAY"
    endchoice

    config EXAMPLE_IO_TYPE
        int
        default 0 if BLE_SM_IO_CAP_DISP_ONLY
        default 1 if BLE_SM_IO_CAP_DISP_YES_NO
        default 2 if BLE_SM_IO_CAP_KEYBOARD_ONLY
        default 3 if BLE_SM_IO_CAP_NO_IO
        default 4 if BLE_SM_IO_CAP_KEYBOARD_DISP

    config EXAMPLE_BONDING
        bool
        default n
        prompt "Use Bonding"
        help
            Use this option to enable/disable bonding.

    config EXAMPLE_MITM
        bool
        default n
        prompt "MITM security"
        help
            Use this option to enable/disable MITM security.

    config EXAMPLE_USE_SC
        bool
        depends on BT_NIMBLE_SM_SC
        default n
        prompt "Use Secure Connection feature"
        help
            Use this option to enable/disable Security Manager Secure Connection 4.2 feature.

    config EXAMPLE_EXTENDED_ADV
        bool
        depends on SOC_BLE_50_SUPPORTED
        default y if SOC_ESP_NIMBLE_CONTROLLER
        select BT_NIMBLE_EXT_ADV
        prompt "Enable Extended Adv"
        help
            Use this option to enable extended advertising in the example.
            If this option is disabled, ensure config BT_NIMBLE_EXT_ADV is
            also disabled from Nimble stack menuconfig

    config EXAMPLE_RANDOM_ADDR
        bool
        prompt "Advertise RANDOM Address"
        help
            Use this option to advertise a random address instead of public address

    config EXAMPLE_ENCRYPTION
        bool
        prompt "Enable Link Encryption"
        help
            This adds Encrypted Read and Write permissions in the custom GATT server.

    config EXAMPLE_RESOLVE_PEER_ADDR
        bool
        prompt "Enable resolving peer address"
        help
            Use this option to enable resolving peer's address.


            
endmenu
```
